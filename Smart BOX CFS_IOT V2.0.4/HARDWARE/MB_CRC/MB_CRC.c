/*********************************************************************************
 * 文件名  ：MB_CRC.c
 * 描述    ：CRC校验
 * 日期    ：2014 07 11 
**********************************************************************************/
#include "stm32f10x.h"
#include "MB_CRC.h"

static const u8 aucCRCHi[] = {
    0x00, 0xC1, 0x81, 0x40, 0x01, 0xC0, 0x80, 0x41, 0x01, 0xC0, 0x80, 0x41,
    0x00, 0xC1, 0x81, 0x40, 0x01, 0xC0, 0x80, 0x41, 0x00, 0xC1, 0x81, 0x40,
    0x00, 0xC1, 0x81, 0x40, 0x01, 0xC0, 0x80, 0x41, 0x01, 0xC0, 0x80, 0x41,
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    0x00, 0xC1, 0x81, 0x40
};

static const u8 aucCRCLo[] = {
    0x00, 0xC0, 0xC1, 0x01, 0xC3, 0x03, 0x02, 0xC2, 0xC6, 0x06, 0x07, 0xC7,
    0x05, 0xC5, 0xC4, 0x04, 0xCC, 0x0C, 0x0D, 0xCD, 0x0F, 0xCF, 0xCE, 0x0E,
    0x0A, 0xCA, 0xCB, 0x0B, 0xC9, 0x09, 0x08, 0xC8, 0xD8, 0x18, 0x19, 0xD9,
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    0x41, 0x81, 0x80, 0x40
};

/**************************************************************
 * 函数名：MB_CRC16
 * 描述  ：ModBus_CRC16校验码生成
 * 输入  ：pucFrame:要校验的缓存首地址
 *         usLen:要校验的长度
 * 输出  : 16位校验码
 **************************************************************/
u16 MB_CRC16( u8 * pucFrame, u8 usLen ){
    u8           ucCRCHi = 0xFF;
    u8           ucCRCLo = 0xFF;
    int             iIndex;

    while( usLen-- )
    {
        iIndex = ucCRCLo ^ *( pucFrame++ );
        ucCRCLo = ( u8 )( ucCRCHi ^ aucCRCHi[iIndex] );
        ucCRCHi = aucCRCLo[iIndex];
    }
    return ( u16 )( ucCRCHi << 8 | ucCRCLo );
}

/**************************************************************
 * 函数名：CRC_TEST
 * 描述  ：检验收到的Modbus校验位是否正确
 * 输入  ：buf:收到的Modbus数据
 *         Len:Modbus长度
 * 输出  : 1:正确 0:错误
 **************************************************************/
u8 CRC_TEST(u8 *buf,u8 len)
{
	u16 CRCHL = 0;
  CRCHL = MB_CRC16(buf,len-2);
	if(buf[len-1] == CRCHL>>8)   //高字节校验
	{
		if(buf[len-2] ==(u8)CRCHL) //低字节校验
			return CRC_OK;       //验证正确
		else 
			return CRC_ERROR;		 //验证错误
	}
	else 
		return  CRC_ERROR;		 //验证错误
}

/**************************************************************
 * 函数名：CRC_TEST
 * 描述  ：为一个指令增加CRC校验 低字节在前 高字节在后
 * 输入  ：buf:收到的Modbus数据
 *         Len:为加CRC校验长度
 * 输出  : 无
 **************************************************************/
void ADD_CRC(u8 *buf,u8 len)
{
	u16 CRCHL = 0;
  CRCHL = MB_CRC16(buf,len);
	buf[len+1] = CRCHL>>8 ;  //高字节校验
	buf[len] =(u8)CRCHL ;  //低字节校验
}


/**************************************************************
 * 函数名：IEEE754_F_H
 * 描述  ：IEEE754 浮点数转换为4位 十六进制数
 *         标准 是 低1 低0 高1 高0  
 *         正常数  高1高0低1低0
 * 输入  ：buf:转换后的十六进制数
 *         f  :小数
 * 输出  : 无
 **************************************************************/
void IEEE754_F_H(float f,u8* buf)
{
  float* p;
	u8* q;
	p = &f;
	q = buf;
	*(q+2) = *((u8*)p+3);//高位 在后面
	*(q+3) = *((u8*)p+2);
	
	*(q+0) = *((u8*)p+0);//低位 在前面
	*(q+1) = *((u8*)p+1);
}

/**************************************************************
 * 函数名：IEEE754_H_F
 * 描述  ：IEEE754 4位 十六进制转换为数浮点数
 *         标准 是 低1 低0 高1 高0  
 *         正常数  高1高0低1低0
 *         ARM存储 低0 低1 高0 高1
 * 输入  ：buf:转换后的十六进制数
 *         f  :小数
 * 输出  : 无
 **************************************************************/
void IEEE754_H_F(u8* buf,float* f)
{
	u8* q;
  u8 rsbuf[4] = {0};

  rsbuf[0] = buf[1];
  rsbuf[1] = buf[0];
  rsbuf[2] = buf[3];
  rsbuf[3] = buf[2];
	q = rsbuf;
	*f = *((float*)q);	

}
